## ite_sdk/ite_sdk/project/test_usbhcc/Kconfig.hid.host
```kconfig
#
# For a description of the syntax of this configuration file,
# see Documentation/kbuild/kconfig-language.txt.
#

mainmenu "Project Configuration"

config CMAKE_SOURCE_DIR
	string
	option env="CMAKE_SOURCE_DIR"

config USBHCC
	def_bool y
	
config USBHCC_HOST
	def_bool y
    
config USBH_CD_HID
    def_bool y

config USB0_ENABLE
	def_bool n

config UART1_ENABLE
    def_bool y

config GPIO_UART1_TX
    default "4"

config GPIO_UART1_RX
    default "-1"

config DEF_DBG_UART1
    def_bool y

source "$CMAKE_SOURCE_DIR/sdk/Kconfig"

menu "USB HID Test"

choice
	prompt "Test App"
	default TEST_HID_HOST

config TEST_HID_HOST
    bool "USB HID HOST"
    depends on USBH_CD_HID

endchoice

endmenu
```

## ite_sdk/ite_sdk/project/test_usbhcc/Kconfig.sd.972
```kconfig
#
# For a description of the syntax of this configuration file,
# see Documentation/kbuild/kconfig-language.txt.
#

mainmenu "Project Configuration"

config CMAKE_SOURCE_DIR
	string
	option env="CMAKE_SOURCE_DIR"

config DEF_CHIP_PKG_IT972
	def_bool y
	
config ROM_COMPRESS
	def_bool n
	
#==== for SD ====
config SD0_ENABLE
	def_bool y

config SD0_STATIC
	default y

config GPIO_SD0_POWER_ENABLE
    default "19"

config GPIO_SD0_WRITE_PROTECT
    default "-1"
	
config GPIO_SD0_IO
      default "15, 5, 7, 8, 9, 10, -1, -1, -1, -1"
	
#config SD1_ENABLE
#	def_bool y

#config SD1_STATIC
#    default y

#config GPIO_SD1_CARD_DETECT
#    default "-1"

#config GPIO_SD1_POWER_ENABLE
#    default "18"

#config GPIO_SD1_WRITE_PROTECT
#    default "-1"

#config GPIO_SD1_IO
#      default "16, 5, 7, 8, 9, 10, -1, -1, -1, -1"

config UART1_ENABLE
    def_bool y

config GPIO_UART1_TX
    default "4"

config GPIO_UART1_RX
    default "-1"

#==== for FAT ====
config FS_FAT
	def_bool y
	
#==== for Task ====
config TASK_DRIVE_PROBE	
	def_bool y
		

source "$CMAKE_SOURCE_DIR/sdk/Kconfig"


menu "Storage Test"

choice
	prompt "Test App"
	default TEST_SD

config TEST_SD
	bool "SD Test"
	depends on (SD0_ENABLE || SD1_ENABLE)
	help
	    This is general storage test with itp. It can test multi-storage at the same time.
	    We can use this test project to run 2 SD.

endchoice

endmenu
```

## ite_sdk/ite_sdk/project/test_usbhcc/Kconfig.usbd.acm
```kconfig
#
# For a description of the syntax of this configuration file,
# see Documentation/kbuild/kconfig-language.txt.
#

mainmenu "Project Configuration"

config CMAKE_SOURCE_DIR
	string
	option env="CMAKE_SOURCE_DIR"

config ROM_COMPRESS
    def_bool n

config USBHCC
	def_bool y

config USBHCC_HOST
	def_bool y

config USBHCC_DEVICE
	def_bool y

config GPIO_USB_ID_PIN
  default "53"

config DEF_USBD_USB0
	def_bool y

config DEF_USBD_CD_CDCACM
	def_bool y

config USB0_ENABLE
	def_bool n
	
config TASK_DRIVE_PROBE	
	def_bool y

config FS_FAT
	def_bool y

#===== enable SD card ======
config SD0_ENABLE
    def_bool y

config SD0_STATIC
    default y

config GPIO_SD0_POWER_ENABLE
    default "19"

config GPIO_SD0_WRITE_PROTECT
    default "-1"

config GPIO_SD0_IO
      default "15, 5, 7, 8, 9, 10, -1, -1, -1, -1"

#===== enable UART ======
config UART1_ENABLE
    def_bool y

config GPIO_UART1_TX
    default "4"

config GPIO_UART1_RX
    default "-1"
	
source "$CMAKE_SOURCE_DIR/sdk/Kconfig"



menu "USB Device Test"

choice
    prompt "As RS232 over USB"
    depends on USBD_CD_CDCACM
    default TEST_ACM_LOOPBACK

config TEST_ACM_LOOPBACK
    bool "Test by loopback"

config TEST_ACM_SEND_FILE
    bool "Transfer file"
    help
        Receive file from PC and save to our internal SD card.
        cmd: send filename filesize

endchoice

endmenu
```

## ite_sdk/ite_sdk/project/test_usbhcc/Kconfig.usbd.mst
```kconfig
#
# For a description of the syntax of this configuration file,
# see Documentation/kbuild/kconfig-language.txt.
#

mainmenu "Project Configuration"

config CMAKE_SOURCE_DIR
	string
	option env="CMAKE_SOURCE_DIR"

config ROM_COMPRESS
    def_bool n

config USBHCC
	def_bool y

config USBHCC_HOST
	def_bool y

config USBHCC_DEVICE
	def_bool y

config GPIO_USB_ID_PIN
  default "53"

config DEF_USBD_USB0
	def_bool y

config DEF_USBD_CD_MST
	def_bool y

config USB0_ENABLE
	def_bool n
	
config TASK_DRIVE_PROBE	
	def_bool y

config FS_FAT
	def_bool y

#===== enable SD card ======
config SD0_ENABLE
    def_bool y

config SD0_STATIC
    default y

config GPIO_SD0_POWER_ENABLE
    default "19"

config GPIO_SD0_WRITE_PROTECT
    default "-1"

config GPIO_SD0_IO
      default "15, 5, 7, 8, 9, 10, -1, -1, -1, -1"

config SD1_ENABLE
    def_bool y

config SD1_STATIC
    default y

config GPIO_SD1_POWER_ENABLE
    default "18"

config GPIO_SD1_WRITE_PROTECT
    default "-1"

config GPIO_SD1_IO
      default "16, 5, 7, 8, 9, 10, -1, -1, -1, -1"

#===== enable UART ======
config UART0_ENABLE
    def_bool y

config GPIO_UART0_TX
    default "4"

config GPIO_UART0_RX
    default "-1"
	
source "$CMAKE_SOURCE_DIR/sdk/Kconfig"



menu "USB Device Mass Storage Test"

choice
	prompt "Test App"
	default TEST_USBD_MST

config TEST_USBD_MST
	bool "As USB Mass Storage "
	depends on USBD_CD_MST

endchoice

endmenu
```

## ite_sdk/ite_sdk/project/test_usbhcc/Kconfig.usbh.acm
```kconfig
#
# For a description of the syntax of this configuration file,
# see Documentation/kbuild/kconfig-language.txt.
#

mainmenu "Project Configuration"

config CMAKE_SOURCE_DIR
	string
	option env="CMAKE_SOURCE_DIR"

config USBHCC
	def_bool y
	
config USBH_CD_CDCACM
	def_bool y

config USB0_ENABLE
	def_bool n

#===== enable SD card ======
config SD0_ENABLE
    def_bool y

config SD0_STATIC
    def_bool y

config GPIO_SD0_POWER_ENABLE
    default "19"

config GPIO_SD0_WRITE_PROTECT
    default "-1"

config GPIO_SD0_IO
      default "15, 5, 7, 8, 9, 10, -1, -1, -1, -1"

config TASK_DRIVE_PROBE	
	def_bool y

config FS_FAT
	def_bool y

#===== enable UART ======
config UART1_ENABLE
    def_bool y

config GPIO_UART1_TX
    default "4"

config GPIO_UART1_RX
    default "-1"
	
source "$CMAKE_SOURCE_DIR/sdk/Kconfig"


menu "USB Host CDC-ACM Test"

choice
  	prompt "Test App"
	  default TEST_USBH_CDCACM_SEND_FILE

config TEST_USBH_CDCACM_SEND_FILE
	  bool "Transfer file"
	  depends on USBH_CD_CDCACM
    help
        Read file from SD card and transfer to another ITE platform.
        Another platform is USB device as CDC-ACM.
        Receive file from PC and save to our internal SD card.
        cmd: send filename filesize
        
config USBH_ACM_FILENAME
    string "File Name"
    depends on TEST_USBH_CDCACM_SEND_FILE
    default "test_020m.zip"
    help
        file name in sd card
                
endchoice

endmenu
```

## ite_sdk/ite_sdk/project/test_usbhcc/Kconfig.usbh.mst
```kconfig
#
# For a description of the syntax of this configuration file,
# see Documentation/kbuild/kconfig-language.txt.
#

mainmenu "Project Configuration"

config CMAKE_SOURCE_DIR
	string
	option env="CMAKE_SOURCE_DIR"

config USBHCC
	def_bool y
	
config USBH_CD_MST
	def_bool y

config USB0_ENABLE
	def_bool n
	
config TASK_DRIVE_PROBE	
	def_bool y

config FS_FAT
	def_bool y

config UART1_ENABLE
    def_bool y

config GPIO_UART1_TX
    default "4"

config GPIO_UART1_RX
    default "-1"
	
source "$CMAKE_SOURCE_DIR/sdk/Kconfig"


menu "USBH Mass Storage Test"

choice
	prompt "Test App"
	default TEST_MST

config TEST_MST
	bool "USB Mass Storage "
	depends on USBH_CD_MST

endchoice

endmenu
```

## ite_sdk/ite_sdk/project/test_uvc/Kconfig
```kconfig
#
# For a description of the syntax of this configuration file,
# see Documentation/kbuild/kconfig-language.txt.
#

mainmenu "Project Configuration"

config TEST_UVC
    bool
    default y
    select HAVE_LCD
    select HAVE_GRAPHICS

config CMAKE_SOURCE_DIR
    string
    option env="CMAKE_SOURCE_DIR"

config RAM_SIZE
    default "0x4000000"

config DCPS_ENABLE
    def_bool y

config BACKLIGHT_ENABLE
    def_bool y

config BACKLIGHT_DUTY_CYCLES
    default "5, 25, 40, 55, 65, 75, 82, 88, 92, 95"

config BACKLIGHT_DEFAULT_DUTY_CYCLE
    default "95"

config LCD_ENABLE
    def_bool y

config LCD_WIDTH
    default "1024"

config LCD_HEIGHT
    default "600"

config LCD_PITCH
    default "2048"

config LCD_INIT_SCRIPT
    default "it970_lcd_joyangit_1024_600_24bits_mipi_128pin_rot180.txt"

config CMDQ_ENABLE
    def_bool y

config M2D_ENABLE
    def_bool y

config USB0_ENABLE
    def_bool y

config USB1_ENABLE
    def_bool y

config UVC_ENABLE
    def_bool y

config JPEG_HW_ENABLE
    default y

config UART0_ENABLE
    def_bool y

config GPIO_UART0_TX
    default "4"

config GPIO_UART0_RX
    default "-1"

config GPIO_BACKLIGHT_PWM
    default "95"

config TASK_DRIVE_PROBE
    def_bool y

config MSC_ENABLE
    def_bool y

config FS_FAT
    def_bool y

config DEF_DBG_UART0
    def_bool y

source "$CMAKE_SOURCE_DIR/sdk/Kconfig"

menu "USB UVC Test"

choice
    prompt "Test App"
    default TEST_UVC

config UVC_EXAMPLE
    bool "USB UVC"
    depends on UVC_ENABLE

endchoice

endmenu
```

## ite_sdk/ite_sdk/project/test_uvc/Kconfig.win32
```kconfig
#
# For a description of the syntax of this configuration file,
# see Documentation/kbuild/kconfig-language.txt.
#

mainmenu "Project Configuration"

config TEST_UVC
    bool
    default y
    select HAVE_LCD
    select HAVE_GRAPHICS

config CMAKE_SOURCE_DIR
    string
    option env="CMAKE_SOURCE_DIR"

config RAM_SIZE
    default "0x4000000"

config BACKLIGHT_ENABLE
    def_bool y

config BACKLIGHT_DUTY_CYCLES
    default "5, 25, 40, 55, 65, 75, 82, 88, 92, 95"

config BACKLIGHT_DEFAULT_DUTY_CYCLE
    default "95"

config UVC_ENABLE
    def_bool y

config JPEG_HW_ENABLE
    default y

source "$CMAKE_SOURCE_DIR/sdk/Kconfig"

menu "USB UVC Test"

choice
    prompt "Test App"
    default TEST_UVC

config UVC_EXAMPLE
    bool "USB UVC"
    depends on UVC_ENABLE

endchoice

endmenu
```

## ite_sdk/ite_sdk/project/test_wifi_sdio/Kconfig
```kconfig
#
# For a description of the syntax of this configuration file,
# see Documentation/kbuild/kconfig-language.txt.
#

mainmenu "Project Configuration"

config CMAKE_SOURCE_DIR
    string
    option env="CMAKE_SOURCE_DIR"

config DEF_CHIP_PKG_IT976
    def_bool y

config ROM_COMPRESS
    def_bool n

#==== for SD ====
config SD0_ENABLE
    def_bool n

config SD0_STATIC
    default n

config AXISPI_ENABLE
    default n

config UART1_ENABLE
    def_bool y

config DEF_UART1_FIFO
	def_bool y
	
if DEF_UART1_FIFO
config UART_FORCE_FLUSH
	def_bool y
endif

#config GPIO_SD0_CARD_DETECT
#   default "98"

#config GPIO_SD0_POWER_ENABLE
#   default "99"

#config GPIO_SD0_WRITE_PROTECT
#   default "100"

config GPIO_SD0_IO
    default "16, 17, 7, 14, 9, 10, -1, -1, -1, -1"

config GPIO_UART1_TX
    default "4"

config GPIO_UART1_RX
    default "-1"

config SD1_ENABLE
    def_bool y

config MMC_ENABLE
      def_bool y

config SD1_STATIC
    def_bool n

config SDIO_ENABLE
      def_bool y

config SDIO1_STATIC
    def_bool y

config GPIO_SD1_IO
      default "16, 17, 7, 14, 9, 10, -1, -1, -1, -1"

#==== for NET ====
config NET_ENABLE
    def_bool y

config NET_WIFI
    def_bool y

config DEF_NET_WIFI_SDIO
    def_bool y

config DEF_NET_WIFI_SDIO_NGPL
    def_bool y

config NET_WIFI_WPA
	def_bool n
	
config NET_WIFI_MGR
	def_bool y
	
config NET_WIFI_SDIO_POWER_ON_OFF_USER_DEFINED
    def_bool n
	
config NET_HTTP
	def_bool n

config PING
	def_bool y

config DHCPS_ADDR_COUNT
    default "254"
    
config NET_WIFI_REDEFINE
	def_bool n

config DEF_BUILD_DEBUGREL
	def_bool y

source "$CMAKE_SOURCE_DIR/sdk/Kconfig"


menu "WIFI SDIO Test"

choice
    prompt "Test App"
    default TEST_SDIO_WIFI_LWIP

config TEST_SDIO_WIFI_LWIP
    bool "Test by TCP socket"
    help
        Connect to AP and test TCP

endchoice

endmenu
```

## ite_sdk/ite_sdk/project/test_wifi_usb/Kconfig
```kconfig
#
# For a description of the syntax of this configuration file,
# see Documentation/kbuild/kconfig-language.txt.
#

mainmenu "Project Configuration"

config CMAKE_SOURCE_DIR
	string
	option env="CMAKE_SOURCE_DIR"

config ROM_COMPRESS
	def_bool n

config UART1_ENABLE
	def_bool y
	
config GPIO_UART1_TX
	default "4"
	
config GPIO_UART1_RX
	default "-1"
#==== for USB ====
config USB0_ENABLE
	def_bool y
      
config USB1_ENABLE
	def_bool y
#==== for NET ====
config NET_ENABLE
	def_bool y
	
config NET_WIFI
	def_bool y

config DEF_NET_WIFI_USB
    def_bool y

config DEF_NET_WIFI_8188EUS_NEW
	def_bool y
	
config NET_WIFI_WPA
	def_bool y
	
config NET_WIFI_MGR
	def_bool y

config NET_WIFI_SDIO_POWER_ON_OFF_USER_DEFINED
	def_bool n

config NET_WIFI_REDEFINE
	def_bool y
	
config DHCPS_ADDR_COUNT
	default "254"

config PING
	def_bool y
	
config DEF_BUILD_DEBUGREL
	def_bool y

source "$CMAKE_SOURCE_DIR/sdk/Kconfig"


menu "WIFI USB Test"

choice
	prompt "Test App"
	default TEST_USB_WIFI_RAW


config TEST_USB_WIFI_LWIP
	bool "Test by TCP socket"
	help
	    Connect to AP and test TCP

endchoice

endmenu
```
