## ite_sdk/ite_sdk/project/dynamic_ui/Kconfig
```kconfig
#
# For a description of the syntax of this configuration file,
# see Documentation/kbuild/kconfig-language.txt.
#

mainmenu "Project Configuration"

config DYNAMIC_UI
    bool
    default y
    select HAVE_LCD
    select HAVE_GRAPHICS
    select HAVE_AUDIO

config CMAKE_SOURCE_DIR
    string
    option env="CMAKE_SOURCE_DIR"

config RAM_SIZE
    default "0x800000"

config TILING_WIDTH_128
    int
    default 0

config WATCHDOG_ENABLE
    def_bool y

config DCPS_ENABLE
    def_bool y

config CPU_WB
    def_bool n

config FONT_FILENAME
    default "DroidSansMono.ttf"

config BACKLIGHT_ENABLE
    def_bool y

config BACKLIGHT_DUTY_CYCLES
    default "5, 25, 40, 55, 65, 75, 82, 88, 92, 95"

config BACKLIGHT_DEFAULT_DUTY_CYCLE
    default "95"

config LCD_ENABLE
    def_bool y

config LCD_WIDTH
    default "1024"

config LCD_HEIGHT
    default "600"

config LCD_PITCH
    default "2048"

config LCD_INIT_SCRIPT
    default "it970_lcd_joyangit_1024_600_24bits_mipi_128pin_rot180.txt"

config LCD_TRIPLE_BUFFER
    def_bool n

config CMDQ_ENABLE
    def_bool y

config M2D_ENABLE
    def_bool y

config JPEG_HW_ENABLE
    def_bool y

config AUDIO_ENABLE
    def_bool y

config AUDIO_DAC_MODULE
    default "itp_dac_ite970.c"

config AUDIO_CODEC_MP3DEC
    def_bool y

config AUDIO_CODEC_WMADEC
    def_bool y

config AUDIO_CODEC_WAV
    def_bool y

config COMPRESS_AUDIO_PLUGIN
    def_bool y
config NOR_ENABLE
    def_bool y

config NOR_USE_AXISPI
    def_bool y

config NOR_ENABLE_QUADMODE
    def_bool y

config NOR_CACHE_SIZE
    default "0x20000"

config NOR_RESERVED_SIZE
    default "0x250000"

config NOR_PARTITION0
    def_bool y

config NOR_PARTITION0_SIZE
    default "0xD00000"

config USB0_ENABLE
    def_bool y

config USB1_ENABLE
    def_bool y

config MSC_ENABLE
    def_bool y

config FS_FAT
    def_bool y

config RTC_ENABLE
    def_bool y

config SPI_ENABLE
    def_bool n

config I2C1_ENABLE
    def_bool y

config GPIO_IIC1_CLK
    default "37"

config GPIO_IIC1_DATA
    default "36"

config GPIO_IIC1_MODE
    default "2"

config TOUCH_ENABLE
    def_bool y

config TOUCH_MODULE
    default "gt911"

config TOUCH_X_MAX_VALUE
    default "0x3FF"

config TOUCH_Y_MAX_VALUE
    default "0x257"

config GPIO_TOUCH_INT
    default "38"

config GPIO_TOUCH_RESET
    default "39"

config GPIO_TOUCH_WAKE
    default "-1"

config DEF_TOUCH_I2C1
    def_bool y

config TOUCH_INTR
    def_bool y

config I2S_ENABLE
    def_bool y

config I2S_SPDIF_ENABLE
    def_bool n
config UART0_ENABLE
    def_bool y

config GPIO_UART0_TX
    default "4"

config GPIO_UART0_RX
    default "-1"

config AXISPI_ENABLE
    def_bool y

config AXISPI_MOSI_GPIO
    default "7"

config AXISPI_MISO_GPIO
    default "8"

config AXISPI_CLOCK_GPIO
    default "5"

config AXISPI_CHIP_SEL_GPIO
    default "6"

config AXISPI_WP_GPIO
    default "9"

config AXISPI_HOLD_GPIO
    default "10"

config GPIO_BACKLIGHT_PWM
    default "95"

config GPIO_EXPANDER_ENABLE
    default n

config NET_ENABLE
    def_bool n

config TASK_DRIVE_PROBE
    def_bool y

config DEF_DBG_UART0
    def_bool y

config DBG_STATS
    def_bool y

config DBG_STATS_HEAP
    def_bool y

config DEF_BUILD_MINSIZEREL
    def_bool y

config ITU_FT_CACHE_ENABLE
    def_bool y

config ITU_FT_CACHE_SIZE
    default "0x20000"

config GCC_LTO
    def_bool y

config BUILD_AUDIO_MGR
    def_bool y

config BUILD_INIPARSER
    def_bool y

config BUILD_ITU
    def_bool y

config BUILD_SDL
    def_bool y

config BUILD_UPGRADE
    def_bool y

######################################################################
# Start of bootloader setting
######################################################################
config BOOTLOADER_ENABLE
    def_bool n

if BOOTLOADER_ENABLE && LCD_ENABLE

config LCD_BOOT_BITMAP
    default "logo.bmp"

config BL_SHOW_LOGO
    def_bool y

endif

if BOOTLOADER_ENABLE

config UPGRADE_BOOTLOADER
    def_bool y

config UPGRADE_IMAGE
    def_bool y

config UPGRADE_DATA
    def_bool y

if UPGRADE_DATA
config UPGRADE_PRIVATE
    def_bool y

endif

config UPGRADE_OPEN_FILE
    def_bool y

config UPGRADE_PARTITION
    def_bool y

config UPGRADE_DELETE_PKGFILE_AFTER_FINISH
    def_bool y

config DEF_UPGRADE_BOOTLOADER_NOR
    def_bool y

config DEF_UPGRADE_IMAGE_NOR
    def_bool y

config UPGRADE_IMAGE_POS
    default "0x80000"

config DEF_UPGRADE_PRIVATE_NOR
    def_bool y
config UPGRADE_NOR_IMAGE
    def_bool y

config UPGRADE_NOR_IMAGE_SIZE
    default "0x1000000"

config BL_LCD_CONSOLE
    def_bool y

config BL_ERR
    def_bool y

config BL_WARN
    def_bool y

config BL_INFO
    def_bool y

config BL_DBG
    def_bool y

endif
######################################################################
# End of bootloader setting
######################################################################

source "$CMAKE_SOURCE_DIR/sdk/Kconfig"
```

## ite_sdk/ite_sdk/project/sports_equipment/Kconfig.win32
```kconfig
#
# For a description of the syntax of this configuration file,
# see Documentation/kbuild/kconfig-language.txt.
#

mainmenu "Project Configuration"

config SPORTS_EQUIPMENT
    bool
    default y
    select HAVE_LCD
    select HAVE_GRAPHICS
    select HAVE_AUDIO

config CMAKE_SOURCE_DIR
	string
	option env="CMAKE_SOURCE_DIR"

config RAM_SIZE
    default "0x4000000"

config WATCHDOG_ENABLE
    def_bool y

config FONT_FILENAME
    default "wqyMicroHei_sports_equipment.ttf"

config BACKLIGHT_ENABLE
    def_bool y

config BACKLIGHT_DUTY_CYCLES
    default "5, 25, 40, 55, 65, 75, 82, 88, 92, 95"

config BACKLIGHT_DEFAULT_DUTY_CYCLE
    default "95"

config LCD_ENABLE
    def_bool y

config LCD_WIDTH
    default "600"

config LCD_HEIGHT
    default "1024"

config LCD_PITCH
    default "1200"

config LCD_INIT_SCRIPT
    default "it970_lcd_joyangit_1024_600_24bits_rgb_128pin.txt"

config CMDQ_ENABLE
    def_bool y

config AUDIO_ENABLE
    def_bool y

config SD0_ENABLE
    def_bool y

config FS_FAT
    def_bool y

config I2C0_ENABLE
    def_bool y

config I2S_ENABLE
    def_bool y

config I2S_SPDIF_ENABLE
    def_bool n

config UART1_ENABLE
    def_bool y

config DEF_IIC0_GPIO_CONFIG_2
    def_bool y

config DEF_DBG_UART1
    def_bool y

config DEF_BUILD_DEBUG
    def_bool y

config SYSTEM_NAME
    default "ITE SportsEquipment"

config UPGRADE_DELETE_PKGFILE_AFTER_FINISH
    def_bool y

config WIN32_SIMULATOR
    def_bool y

config ITU_FT_CACHE_ENABLE
    def_bool y

config ITU_UCL_ENABLE
    def_bool y

config BUILD_AUDIO_MGR
    def_bool y

config BUILD_INIPARSER
    def_bool y

config BUILD_ITU
    def_bool y

config BUILD_SDL
    def_bool y

config BUILD_UPGRADE
    def_bool y

source "$CMAKE_SOURCE_DIR/sdk/Kconfig"

######################################################################
# Project Menu
######################################################################
menu "SportsEquipment"

    config CHECK_FILES_CRC_ON_BOOTING
        bool "Checking files' CRC on booting time"
        default n
        help
            Checking files' CRC on booting time
        help_cht
            開啟開機時檢查檔案 CRC 值的功能。
        help_chs
            开启开机时检查档案 CRC 值的功能。

    config ITU_PATH
        string "ITU files path"
        default "itu/1024x600"
        help
            ITU files path
        help_cht
            ITU檔案路徑。
        help_chs
            ITU档案路径。

    config RES_PATH
        string "Resource files path"
        default "res"
        help
            Resource files path
        help_cht
            資源檔案路徑。
        help_chs
            资源档案路径。

    config UPGRADE_GUI
        bool "Upgrade by graphics display"
        default n
        help
            Upgrade by graphics display
        help_cht
            圖形顯示更新。
        help_chs
            图形显示更新。

endmenu
```

## ite_sdk/ite_sdk/project/test_audio/Kconfig
```kconfig
#
# For a description of the syntax of this configuration file,
# see Documentation/kbuild/kconfig-language.txt.
#

mainmenu "Project Configuration"

config PROJECT_MODULE_DEFINED
    bool
    default y
    #select HAVE_LCD
    #select HAVE_GRAPHICS
    select HAVE_AUDIO
    #select HAVE_VIDEO

config RAM_INIT_SCRIPT
    default "IT970A0_396Mhz_DDR2_396Mhz.scr"

config CMAKE_SOURCE_DIR
    string
    option env="CMAKE_SOURCE_DIR"

config I2S_ENABLE
    def_bool y

config AUDIO_ENABLE
    def_bool y

config AUDIO_DAC_MODULE
    default "itp_dac_ite970.c"
    
config UART0_ENABLE
    def_bool y

config GPIO_UART0_TX
    default "4"

config GPIO_UART0_RX
    default "-1"

config FS_FAT
	def_bool y

config USB0_ENABLE
    def_bool y

config MSC_ENABLE
    def_bool y

config TASK_DRIVE_PROBE
    def_bool y
    
config BUILD_AUDIO_MGR
    def_bool y
    
config AUDIO_CODEC_MP3DEC
    def_bool y

config AUDIO_CODEC_WAV
    def_bool y
    
config	AMPLIFIER_ENABLE
    def_bool y

config AMPLIFIER_MODULE
    default "itp_amp_gpio.c"

config GPIO_AMPLIFIER_ENABLE
    default "25"

config GPIO_AMPLIFIER_MUTE
    default "25"

config DEF_DBG_UART0
    def_bool y

config DBG_INIT_SCRIPT
    default "IT970A0_396Mhz_DDR2_396Mhz.txt"

menu "TEST AUDIO"

    choice
    prompt "Select Test Item"
    default TEST_AUDIO_HW_CTRL
    help
        select test item.

    config TEST_AUDIO_HW_CTRL
    bool "test audio HW control"
    help
        test audio HW control (IIS DAC layout...)
        
    config TEST_AUDIO_FLOW
    bool "test audio FLOW "
    help
        test audio FLOW API

    config TEST_AUDIOMGR_PLAY
    bool "test audio MGR "
    help
        test audio MGR API
        
    endchoice

    choice
    depends on TEST_AUDIO_HW_CTRL
    prompt "test audio HW ctrl"
    default TEST_HW_PLAY
    help
        audioHWctrl/
        HW ctrl

    config TEST_HW_PLAY
    bool "HW iis play"
    help
        test_main_simple.c
        simple iis test play sound.(DA TEST)

    config TEST_HW_USBWAV_PLAY
    bool "HW usbwav play"
    help
        test_main_usb_play.c
        usb disk wav file play test.(DA & USB TEST)

    config TEST_HW_USBWAV_RECORD
    bool "HW usbwav record"
    help
        test_main_usb_record.c
        usb disk wav record file test.(AD & USB TEST)

#    config AD_REC_DA_PLAY_TEST
#    bool "AD record & DA play sound test"
#    help
#        TEST AD record & DA play sound.

    config TEST_HW_LOUDER
    bool "HW louder"
    help
        test_main_louder.c
        louder(AD & DA TEST).
        
#    config FFT_SNR_TEST
#    bool "ffr snr record test"
#    help
#        1K tone out record test(output feedback to input) FFT meansure SNR.
#    help_cht
#        1K 頻率錄音(輸出回灌到輸入) FFT 測量 SNR。
#    help_chs
#        1K 頻率錄音(輸出回灌到輸入) FFT 測量 SNR。
        
#    config BIST_OUT_RECORD_TEST
#    bool "bist out record test"
#    help
#        1K tone out record test(output feedback to input).
#    help_cht
#        1K 頻率錄音(輸出回灌到輸入)。
#    help_chs
#        1K 頻率錄音(輸出回灌到輸入)。

    endchoice
    
    choice
    depends on TEST_AUDIO_FLOW
    prompt "test audio flow louder"
    default TEST_FLOWER_LAOUDER
    help
        audioFlow/
        audio FLOW API

    config TEST_FLOWER_PLAY
        bool "FLOWER play"
        help
            test_flower_play.c
            play a:/Music8k1c.wav

    config TEST_FLOWER_USBREC
        bool "FLOWER usbrec"
        help
            test_flower_usbrec.c
            rec a:/rec.wav

    config TEST_FLOWER_MIX
        bool "FLOWER mix"
        help
            test_flower_mix.c
            paly a:/Music8k1c.wav
            mix a:/0.wav a:/1.wav a:/2.wav a:/3.wav
    
    config TEST_FLOWER_ASR
        bool "FLOWER asr"
        help
            test_flower_asr.c
        
    config TEST_FLOWER_LAOUDER
        bool "FLOWER louder"
        help
            test_flower_louader.c
            mic in & spk out
	
	config TEST_FLOWER_LAOUDER_MIX
        bool "FLOWER louder with mix"
        help
            test_flower_louader_mix.c
            mic in & spk out with mix a:/0.wav a:/1.wav a:/2.wav a:/3.wav

    config TEST_FLOWER_ANALOGSPK
        bool "FLOWER analog speaker"
        help
            test_flower_analogskl.c
            analog mic in & spk out

    config TEST_FLOWER_RESAMPLE_PLAY
        bool "FLOWER resample play"
        help
            test_flower_resample_play.c
            play a:/test.wav and resample to another sample rate(default:48K)
			
	config TEST_FLOWER_RESAMPLE_PLAY_ASR
        bool "FLOWER resample play and asr"
        help
            test_flower_resample_play_with_asr.c
            play a:/test.wav and asr
            
    config TEST_FLOWER_STREAM_PLAY
        bool "FLOWER stream play"
        help
            test_flower_stream.c
            play a:/test.mp3

    endchoice
    
    choice
    depends on TEST_AUDIOMGR_PLAY
    prompt "test audio MGR API"
    default AUDIOMGR_PLAY_TEST
    help
        audioMgr/
        audiomgr API.
        
    config AUDIOMGR_PLAY_TEST
    bool "AUDIOMGR play"
    help
        test_main_audiomgr.c
        usb disk audiomgr test(audio codec:mp3 wma wav).
        
    #config MP3_CODEC_TEST
    #bool "mp3 codec decoder test"
    #help
    #    mp3 codec decoder test.
           
    endchoice

endmenu

if TEST_AUDIO_FLOW
    config BUILD_FLOWER
        def_bool y
    
    config BUILD_ASR
        def_bool y
    
    config ASR_LIB_MODULE
        default "libasr_ITE01.a" 
        
    config SINGLE_GROUND_MODE
        def_bool y
        
    config BUILD_AUDIO_PREPROCESS
        def_bool y
        
    config DIALOGUE_PARAMETER_SET
        def_bool y
        
    config AEC_ENABLE
        def_bool y
        
    config AEC_DELAY_MS
        default "0"
        
    config BUILD_SPEEX
        def_bool y
endif

source "$CMAKE_SOURCE_DIR/sdk/Kconfig"
```
