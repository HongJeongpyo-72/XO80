## ite_sdk/ite_sdk/project/test_lcd/Kconfig
```kconfig
#
# For a description of the syntax of this configuration file,
# see Documentation/kbuild/kconfig-language.txt.
#

mainmenu "Project Configuration"

config TEST_LCD
    bool
    default y
    select HAVE_LCD
    select HAVE_GRAPHICS
    select HAVE_VIDEO

config CMAKE_SOURCE_DIR
    string
    option env="CMAKE_SOURCE_DIR"

config RAM_SIZE
    default "0x4000000"

config LCD_ENABLE
    def_bool y

config LCD_WIDTH
    default "1024"

config LCD_HEIGHT
    default "600"

config LCD_PITCH
    default "2048"

config LCD_INIT_SCRIPT
    default "it970_lcd_joyangit_1024_600_24bits_mipi_128pin_rot180.txt"

config BACKLIGHT_ENABLE
    def_bool y

config BACKLIGHT_DUTY_CYCLES
    default "5, 25, 40, 55, 65, 75, 82, 88, 92, 95"

config BACKLIGHT_DEFAULT_DUTY_CYCLE
    default "95"

config GPIO_BACKLIGHT_PWM
     default "95"

config UART0_ENABLE
    def_bool y

config GPIO_UART0_TX
    default "4"

config GPIO_UART0_RX
    default "-1"

config DEF_DBG_UART0
    def_bool y

source "$CMAKE_SOURCE_DIR/sdk/Kconfig"

menu "LCD Test"

    choice
        prompt "Test App"
        default TEST_LCD_COLOR

    config TEST_LCD_COLOR
        bool "LCD_COLOR"

    config TEST_LCD_INTR
        bool "LCD_INTR"

    config TEST_LCDCONSOLE
        bool "LCDCONSOLE"

    config TEST_OSDCONSOLE
        bool "OSDCONSOLE"

    config TEST_BACKLIGHT
        bool "BACKLIGHT"

    config TEST_STNLCD
        bool "STNLCD"

    endchoice

endmenu
```

## ite_sdk/ite_sdk/project/test_lcd/Kconfig.win32
```kconfig
#
# For a description of the syntax of this configuration file,
# see Documentation/kbuild/kconfig-language.txt.
#

mainmenu "Project Configuration"

config TEST_LCD
    bool
    default y
    select HAVE_LCD
    select HAVE_GRAPHICS
    select HAVE_AUDIO
    select HAVE_VIDEO

config CMAKE_SOURCE_DIR
    string
    option env="CMAKE_SOURCE_DIR"

config RAM_SIZE
    default "0x4000000"

config BACKLIGHT_ENABLE
    def_bool y

config BACKLIGHT_DUTY_CYCLES
    default "5, 25, 40, 55, 65, 75, 82, 88, 92, 95"

config BACKLIGHT_DEFAULT_DUTY_CYCLE
    default "95"

config GPIO_BACKLIGHT_PWM
     default "64"

source "$CMAKE_SOURCE_DIR/sdk/Kconfig"

menu "LCD Test"

    choice
        prompt "Test App"
        default TEST_LCD_COLOR

    config TEST_LCD_COLOR
        bool "LCD_COLOR"

    config TEST_LCD_INTR
        bool "LCD_INTR"

    config TEST_LCDCONSOLE
        bool "LCDCONSOLE"

    config TEST_OSDCONSOLE
        bool "OSDCONSOLE"

    config TEST_BACKLIGHT
        bool "BACKLIGHT"

    config TEST_STNLCD
        bool "STNLCD"

    endchoice

endmenu
```

## ite_sdk/ite_sdk/project/test_nor/Kconfig
```kconfig
#
# For a description of the syntax of this configuration file,
# see Documentation/kbuild/kconfig-language.txt.
#

mainmenu "Project Configuration"

config CMAKE_SOURCE_DIR
	string
	option env="CMAKE_SOURCE_DIR"
	
config FS_FAT
	def_bool n
	
config NOR_ENABLE
	def_bool y
	
config UART1_ENABLE
    def_bool y
    
config GPIO_UART1_TX
    default "4"

config GPIO_UART1_RX
    default "-1"

config SPI_ENABLE

config DEF_DBG_UART1
    def_bool y

source "$CMAKE_SOURCE_DIR/sdk/Kconfig"

menu "SPI Slave Test"
    depends on SPI0_ENABLE && SPI1_ENABLE && !NOR_USE_AXISPI

config SPI_SLAVE_TEST
    bool "SPI BIST each other"

endmenu
```

## ite_sdk/ite_sdk/project/test_pthread/Kconfig
```kconfig
#
# For a description of the syntax of this configuration file,
# see Documentation/kbuild/kconfig-language.txt.
#

mainmenu "Project Configuration"

config TEST_PTHREAD
    bool
    default y
    #select HAVE_LCD
    #select HAVE_GRAPHICS
    #select HAVE_AUDIO
    #select HAVE_VIDEO

config CMAKE_SOURCE_DIR
    string
    option env="CMAKE_SOURCE_DIR"

config RAM_SIZE
    default "0x4000000"

config UART0_ENABLE
    def_bool y

config GPIO_UART0_TX
    default "4"

config GPIO_UART0_RX
    default "-1"

config DEF_DBG_UART0
    def_bool y

source "$CMAKE_SOURCE_DIR/sdk/Kconfig"
```

## ite_sdk/ite_sdk/project/test_rs485/Kconfig
```kconfig
#
# For a description of the syntax of this configuration file,
# see Documentation/kbuild/kconfig-language.txt.
#

mainmenu "Project Configuration"

config TEST_RS485
    bool
    default y

config CMAKE_SOURCE_DIR
    string
    option env="CMAKE_SOURCE_DIR"

config UART0_ENABLE
    def_bool y

config GPIO_UART0_TX
    default "4"

config GPIO_UART0_RX
    default "-1"

config DEF_DBG_UART0
    def_bool y

config RS485_1_ENABLE
    def_bool y

config GPIO_RS485_1_TX
    default "52"

config GPIO_RS485_1_TX_ENABLE
    default "54"

config GPIO_RS485_1_RX
    default "53"

source "$CMAKE_SOURCE_DIR/sdk/Kconfig"
```

## ite_sdk/ite_sdk/project/test_rs485/Kconfig.win32
```kconfig
#
# For a description of the syntax of this configuration file,
# see Documentation/kbuild/kconfig-language.txt.
#

mainmenu "Project Configuration"

config TEST_CAPTURE
    bool
    default y
    select HAVE_LCD
    select HAVE_GRAPHICS
    select HAVE_VIDEO

config CMAKE_SOURCE_DIR
    string
    option env="CMAKE_SOURCE_DIR"

config BACKLIGHT_ENABLE
    def_bool y

config BACKLIGHT_DUTY_CYCLES
    default "5, 25, 40, 55, 65, 75, 82, 88, 92, 95"

config BACKLIGHT_DEFAULT_DUTY_CYCLE
    default "95"

config VIDEO_ENABLE
    def_bool y

config I2C0_ENABLE
    def_bool y

config DEF_IIC0_GPIO_CONFIG_2
    def_bool y

config DEV_TEST
    def_bool n

config WIN32_SIMULATOR
    def_bool n

config CAPTURE_MODULE_ENABLE
    def_bool y

source "$CMAKE_SOURCE_DIR/sdk/Kconfig"

menu "LCD Test"

    choice
        prompt "Test App"
        default TEST_LCD_COLOR

    config TEST_LCD_COLOR
        bool "LCD_COLOR"

    config TEST_LCD_INTR
        bool "LCD_INTR"

    config TEST_LCDCONSOLE
        bool "LCDCONSOLE"

    config TEST_OSDCONSOLE
        bool "OSDCONSOLE"

    config TEST_BACKLIGHT
        bool "BACKLIGHT"

    config TEST_STNLCD
        bool "STNLCD"

    endchoice

endmenu
```

## ite_sdk/ite_sdk/project/test_sd/Kconfig.977
```kconfig
#
# For a description of the syntax of this configuration file,
# see Documentation/kbuild/kconfig-language.txt.
#

mainmenu "Project Configuration"

config CMAKE_SOURCE_DIR
    string
    option env="CMAKE_SOURCE_DIR"

config DEF_CHIP_PKG_IT977
    def_bool y

config ROM_COMPRESS
    def_bool n

#==== for SD ====
config SD0_ENABLE
    def_bool y

config SD0_STATIC
    default n

config GPIO_SD0_CARD_DETECT
    default "18"

config GPIO_SD0_POWER_ENABLE
    default "19"

config GPIO_SD0_WRITE_PROTECT
    default "-1"

config GPIO_SD0_IO
    default "11, 5, 7, 8, 9, 10, -1, -1, -1, -1"

config SD1_ENABLE
    def_bool y

config SD1_STATIC
    default n

config GPIO_SD1_CARD_DETECT
    default "22"

config GPIO_SD1_POWER_ENABLE
    default "23"

config GPIO_SD1_WRITE_PROTECT
    default "-1"

config GPIO_SD1_IO
      default "12, 5, 7, 8, 9, 10, -1, -1, -1, -1"

config UART1_ENABLE
    def_bool y

config GPIO_UART1_TX
    default "4"

config GPIO_UART1_RX
    default "-1"

#==== for FAT ====
config FS_FAT
    def_bool y

#==== for Script ====
config DBG_INIT_SCRIPT
    default "IT970A0_396Mhz_DDR2_396Mhz.txt"


source "$CMAKE_SOURCE_DIR/sdk/Kconfig"


menu "SD Test"

choice
    prompt "Test App"
    default TEST_SINGLE_SD

config TEST_SCAN_WINDOW
    bool "Scan window for SD"
    help
        Scan window for SD.

config TEST_SINGLE_SD
    bool "Test SD0 or SD1"
    help
        Test only one SD.

config TEST_TWO_SD
    bool "Test 2 SD"
    help
        Test 2 SD with 2 task.

config TEST_ERASE
    bool "Test Erase"
    help
        It will erase 512MB.

endchoice


choice
    prompt "Choose SD"
    default TEST_SD0
    depends on TEST_SINGLE_SD

config TEST_SD0
    bool "SD0"

config TEST_SD2
    bool "SD2"

endchoice



endmenu
```

## ite_sdk/ite_sdk/project/test_sd/Kconfig.win32
```kconfig
#
# For a description of the syntax of this configuration file,
# see Documentation/kbuild/kconfig-language.txt.
#

mainmenu "Project Configuration"

config CMAKE_SOURCE_DIR
    string
    option env="CMAKE_SOURCE_DIR"

config DEF_CHIP_PKG_IT976
    def_bool y

config ROM_COMPRESS
    def_bool n

#==== for SD ====
config SD0_ENABLE
    def_bool y

config SD0_STATIC
    default y

#config GPIO_SD0_CARD_DETECT
#   default "98"

#config GPIO_SD0_POWER_ENABLE
#   default "99"

#config GPIO_SD0_WRITE_PROTECT
#   default "100"

config GPIO_SD0_IO
    default "11, 5, 7, 8, 9, 10, -1, -1, -1, -1"

#config SD1_ENABLE
#   def_bool y

config MMC_ENABLE
    def_bool y

#config SD1_STATIC
#   def_bool n

config SDIO_ENABLE
      def_bool y

config SDIO1_STATIC
    def_bool y

config GPIO_SD1_IO
      default "12, 17, 7, 15, 9, 10, -1, -1, -1, -1"

#==== for NET ====
config NET_ENABLE
    def_bool y

config NET_ETHERNET
    def_bool y

config GPIO_ETHERNET
    default "25, 26, 27, 28, 29, 30, 31, 32, 33, 34, 35, 36, 37, 38, 39"

config GPIO_ETHERNET_LINK
    default "24"

config DEF_NET_AMEBA_SDIO
    def_bool y

#config DBG_INIT_SCRIPT
#    default "p970a0_MEM40M_0901TOP.txt"

source "$CMAKE_SOURCE_DIR/sdk/Kconfig"


menu "Ameba SDIO Test"

choice
    prompt "Test App"
    default TEST_AMEBA_RAW

config TEST_AMEBA_RAW
    bool "Without lwip"
    help
        Test without lwip.

config TEST_AMEBA_LWIP
    bool "Test by ping"
    help
        Ping by another PC and our IP is 192.168.1.249

config TEST_AMEBA_FTP
    bool "Test by ftp"
    help
        FTP server 192.168.1.100 and ......

endchoice

endmenu
```

## ite_sdk/ite_sdk/project/test_uart/Kconfig
```kconfig
#
# For a description of the syntax of this configuration file,
# see Documentation/kbuild/kconfig-language.txt.
#

mainmenu "Project Configuration"

config TEST_UART
    bool
    default y
    #select HAVE_LCD
    #select HAVE_GRAPHICS
    #select HAVE_AUDIO
    #select HAVE_VIDEO

config CMAKE_SOURCE_DIR
    string
    option env="CMAKE_SOURCE_DIR"

config FS_FAT
    def_bool n

config UART0_ENABLE
    def_bool y

config UART1_ENABLE
    def_bool y

config GPIO_UART1_TX
    default "4"

config GPIO_UART1_RX
    default "-1"

config NOR_ENABLE
    def_bool y

config SPI_ENABLE

config DEF_DBG_UART1
    def_bool y

config UART_INTR
    def_bool y

source "$CMAKE_SOURCE_DIR/sdk/Kconfig"
```

## ite_sdk/ite_sdk/project/test_usbd_ncm/Kconfig
```kconfig
#
# For a description of the syntax of this configuration file,
# see Documentation/kbuild/kconfig-language.txt.
#

mainmenu "Project Configuration"

config CMAKE_SOURCE_DIR
    string
    option env="CMAKE_SOURCE_DIR"

config ROM_COMPRESS
    def_bool n
    
config UART1_ENABLE
    def_bool y

config GPIO_UART1_TX
    default "4"

config GPIO_UART1_RX
    default "-1"

#===== enable USB ======
config USB0_ENABLE
    def_bool y

config USB1_ENABLE
    def_bool y

config USB_DEVICE
    def_bool y

config DEF_USB_DEVICE_USB1
    def_bool y

config GPIO_USB_ID_PIN
    default "51"

#==== for NET ====
config NET_ENABLE
    def_bool y

config NET_ETHERNET
    def_bool n

config USBD_NCM
    def_bool y

config NET_HTTP
    def_bool y
    
config PING
    def_bool y


source "$CMAKE_SOURCE_DIR/sdk/Kconfig"


menu "USB Gadget Test"

choice
    prompt "As NCM Device"
    default TEST_PING

config TEST_NONE
    bool "Do Nothing"
    help
        It can be ping by HOST. Our IP is 192.168.2.100.

config TEST_PING
    bool "Ping Host"
    help
        Test with Ping.

config PING_IP
    string "IP"
    depends on TEST_PING
    default "192.168.2.99"
    help

config TEST_SOCKET
    bool "Keep Socket Connect"
    help
        Keep Socket Connect.

endchoice

endmenu
```

## ite_sdk/ite_sdk/project/test_usbh_cd_printer/Kconfig
```kconfig
#
# For a description of the syntax of this configuration file,
# see Documentation/kbuild/kconfig-language.txt.
#

mainmenu "Project Configuration"

config CMAKE_SOURCE_DIR
	string
	option env="CMAKE_SOURCE_DIR"

config ROM_COMPRESS
    def_bool n

config USBHCC
	def_bool y

config USBHCC_HOST
	def_bool y

config USBH_CD_PRINTER
	def_bool y

config USBHCC_DEVICE
	def_bool n

config GPIO_USB_ID_PIN
  default "53"

config DEF_USBD_USB0
	def_bool n

config USB0_ENABLE
	def_bool n
	
config TASK_DRIVE_PROBE	
	def_bool y

config FS_FAT
	def_bool y

config UART0_ENABLE
	def_bool y
	
config GPIO_UART0_TX
	default "4"
	
config GPIO_UART0_RX
	default "-1"

config UART1_ENABLE
	def_bool y
	
config GPIO_UART1_TX
	default "19"
	
config GPIO_UART1_RX
	default "18"

config DEF_DBG_UART0
	def_bool y
	
source "$CMAKE_SOURCE_DIR/sdk/Kconfig"
```

## ite_sdk/ite_sdk/project/test_usbh_cd_rndis/Kconfig
```kconfig
#
# For a description of the syntax of this configuration file,
# see Documentation/kbuild/kconfig-language.txt.
#

mainmenu "Project Configuration"

config CMAKE_SOURCE_DIR
	string
	option env="CMAKE_SOURCE_DIR"

config ROM_COMPRESS
    def_bool n

config USBHCC
	def_bool y

config USBHCC_HOST
	def_bool y

config USBH_CD_PRINTER
	def_bool n

config USBH_CD_RNDIS
	def_bool y

config USBHCC_DEVICE
	def_bool n

config DEF_USBD_USB0
	def_bool n

config USB0_ENABLE
	def_bool n
	
config TASK_DRIVE_PROBE	
	def_bool y

config FS_FAT
	def_bool y

config UART0_ENABLE
    def_bool y

config GPIO_UART0_TX
    default "4"

config GPIO_UART0_RX
    default "-1"
	
source "$CMAKE_SOURCE_DIR/sdk/Kconfig"
```

## ite_sdk/ite_sdk/project/test_usbhcc/Kconfig.hid.device
```kconfig
#
# For a description of the syntax of this configuration file,
# see Documentation/kbuild/kconfig-language.txt.
#

mainmenu "Project Configuration"

config CMAKE_SOURCE_DIR
	string
	option env="CMAKE_SOURCE_DIR"

config USBHCC
	def_bool y

config USBHCC_DEVICE
	def_bool y

config DEF_USBD_USB0
	def_bool y

config DEF_USBD_CD_HID
	def_bool y

config USB0_ENABLE
	def_bool n

config UART1_ENABLE
    def_bool y

config GPIO_UART1_TX
    default "4"

config GPIO_UART1_RX
    default "-1"

config DEF_DBG_UART1
    def_bool y

config GPIO_USB_ID_PIN
    default "51"
    
source "$CMAKE_SOURCE_DIR/sdk/Kconfig"

menu "USB HID Test"

choice
	prompt "Test App"
	default TEST_HID_DEVICE

config TEST_HID_DEVICE
    bool "USB HID DEVICE"
    depends on DEF_USBD_CD_HID

endchoice

endmenu
```
