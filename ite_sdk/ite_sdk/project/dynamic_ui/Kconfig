## ite_sdk/ite_sdk/project/test_audio/audio_called/Kconfig
```kconfig
#
# For a description of the syntax of this configuration file,
# see Documentation/kbuild/kconfig-language.txt.
#

mainmenu "Project Configuration"

config PROJECT_MODULE_DEFINED
    bool
    default y
    #select HAVE_LCD
    #select HAVE_GRAPHICS
    select HAVE_AUDIO
    #select HAVE_VIDEO

config RAM_INIT_SCRIPT
    default "IT970A0_396Mhz_DDR2_396Mhz.scr"

config CMAKE_SOURCE_DIR
    string
    option env="CMAKE_SOURCE_DIR"

config I2S_ENABLE
    def_bool y

config AUDIO_ENABLE
    def_bool y

config AUDIO_DAC_MODULE
    default "itp_dac_ite970.c"

config GPIO_UART0_TX
    default "4"

config GPIO_UART0_RX
    default "-1"

config FS_FAT
	def_bool y

config USB0_ENABLE
    def_bool y

config MSC_ENABLE
    def_bool y

config TASK_DRIVE_PROBE
    def_bool y
    
config	AMPLIFIER_ENABLE
    def_bool y

config AMPLIFIER_MODULE
    default "itp_amp_gpio.c"

config GPIO_AMPLIFIER_ENABLE
    default "25"

config GPIO_AMPLIFIER_MUTE
    default "25"

config DBG_INIT_SCRIPT
    default "IT970A0_396Mhz_DDR2_396Mhz.txt"

config BUILD_FLOWER
    def_bool y
        
config BUILD_AUDIO_PREPROCESS
    def_bool y
        
config DIALOGUE_PARAMETER_SET
    def_bool y
        
config AEC_ENABLE
    def_bool y
        
config AEC_DELAY_MS
    default "0"
    
config BUILD_SPEEX
    def_bool y
    
config NET_ENABLE
    def_bool y
    
config GPIO_ETHERNET_LINK
    default "37"

config GPIO_ETHERNET
    default "27, 28, 29, 30, 31, 32, 33, 34, 35, 36"

if NET_ENABLE
config NET_ETHERNET
    def_bool y

config DEF_NET_IP101GR
    def_bool y
endif

config NET_ETHERNET_LINK_INTR
    def_bool y

config NET_ETHERNET_MAC_ADDR_RANDOM
    def_bool y

if NET_ETHERNET
config NET_ETHERNET_MAC_ADDR_STORAGE
    def_bool y
endif

if NET_ETHERNET_MAC_ADDR_STORAGE

config NET_ETHERNET_MAC_ADDR_POS
    default "0x70000"

config NET_ETHERNET_MAC_ADDR_UPGRADE
    def_bool y

endif

config NET_ETHERNET_PHY_ADDR
  default "1"

config NET_HTTP
    def_bool y

config NET_FTP
    def_bool y

if NET_FTP_SERVER
config BUILD_LWIP_FTPD
    def_bool y
endif

config NET_DHCP_SERVER
    def_bool y

config DHCPS_ADDR_COUNT
  default "254"

config PING
	def_bool y
    
menu "TEST AUDIO"
 
    choice
    prompt "Test Audio Filter Flow"
    default AUDIOFILTER_CALLED_TEST
    help
        test audio filter called.
    help_cht
        測試audio filter called
    help_chs
        測試audio filter called
        
    config AUDIOFILTER_CALLED_TEST
    bool "audio filter called test"
    help
        audio filter called test.
    help_cht
        audio filter called test。
    help_chs
        audio filter called test。

    config AUDIOFILTER_CALLING_TEST
    bool "audio filter calling test"
    help
        audio filter calling test.
    help_cht
        audio filter calling test。
    help_chs
        audio filter calling test。
        
    endchoice

endmenu

source "$CMAKE_SOURCE_DIR/sdk/Kconfig"
```

## ite_sdk/ite_sdk/project/test_canbus/Kconfig
```kconfig
#
# For a description of the syntax of this configuration file,
# see Documentation/kbuild/kconfig-language.txt.
#

mainmenu "Project Configuration"

config TEST_UART
    bool
    default y
    #select HAVE_LCD
    #select HAVE_GRAPHICS
    #select HAVE_AUDIO
    #select HAVE_VIDEO

config CMAKE_SOURCE_DIR
    string
    option env="CMAKE_SOURCE_DIR"

config FS_FAT
    def_bool n

config UART1_ENABLE
    def_bool y

config GPIO_UART1_TX
    default "4"

config GPIO_UART1_RX
    default "-1"

config NOR_ENABLE
    def_bool n

config SPI0_ENABLE
    def_bool n

config SPI0_MISO_GPIO
    default "58"

config SPI0_MOSI_GPIO
    default "57"

config SPI0_CLOCK_GPIO
    default "55"

config SPI0_CHIP_SEL_GPIO
    default "56"

config SPI1_ENABLE
    def_bool y

config SPI1_MISO_GPIO
    default "50"

config SPI1_MOSI_GPIO
    default "49"

config SPI1_CLOCK_GPIO
    default "47"

config SPI1_CHIP_SEL_GPIO
    default "48"

config CANBUS_ENABLE
    def_bool y

config GPIO_CANBUS_GEN_INT
    default "44"

config GPIO_CANBUS_INT0
    default "46"

config GPIO_CANBUS_INT1
    default "45"

config GPIO_CANBUS_STBY
    default "-1"

config CANBUS1_ENABLE
    def_bool n

config GPIO_CANBUS1_GEN_INT
    default "52"

config GPIO_CANBUS1_INT0
    default "54"

config GPIO_CANBUS1_INT1
    default "53"

config GPIO_CANBUS1_STBY
    default "-1"

config DEF_DBG_UART1
    def_bool y

source "$CMAKE_SOURCE_DIR/sdk/Kconfig"
```

## ite_sdk/ite_sdk/project/test_canbus/Kconfig.win32
```kconfig
#
# For a description of the syntax of this configuration file,
# see Documentation/kbuild/kconfig-language.txt.
#

mainmenu "Project Configuration"

config CMAKE_SOURCE_DIR
    string
    option env="CMAKE_SOURCE_DIR"

config TEST_CANBUS
    bool
    default y

config CANBUS_ENABLE
    def_bool y

config RAM_SIZE
    default "0x4000000"

config UART1_ENABLE
    def_bool y

config GPIO_UART1_TX
    default "4"

config GPIO_UART1_RX
    default "-1"

config WATCHDOG_ENABLE
    def_bool n
    
config RTC_ENABLE
    def_bool n
    
source "$CMAKE_SOURCE_DIR/sdk/Kconfig"
```

## ite_sdk/ite_sdk/project/test_cap/Kconfig
```kconfig
#
# For a description of the syntax of this configuration file,
# see Documentation/kbuild/kconfig-language.txt.
#

mainmenu "Project Configuration"

config TEST_CAP
    bool
    default y
    select HAVE_LCD
    select HAVE_GRAPHICS
    select HAVE_VIDEO
    select HAVE_AUDIO

config CMAKE_SOURCE_DIR
    string
    option env="CMAKE_SOURCE_DIR"

config DEF_CPU_FA626
    def_bool y

config RAM_SIZE
    default "0x4000000"

config LCD_ENABLE
    def_bool y

config LCD_WIDTH
    default "480"

config LCD_HEIGHT
    default "272"

config LCD_PITCH
    default "960"

config LCD_INIT_SCRIPT
    default "it970a0_LCD_innolux_480_272_rgb_24bits_128pin.txt"

config BACKLIGHT_ENABLE
    def_bool y

config BACKLIGHT_DUTY_CYCLES
    default "5, 25, 40, 55, 65, 75, 82, 88, 92, 95"

config GPIO_BACKLIGHT_PWM
     default "59"

config BACKLIGHT_DEFAULT_DUTY_CYCLE
    default "95"

config GPIO_BACKLIGHT_PWM
    default "59"
    
config GPIO_PWM_NUMBER
    default "4"
    
config GPIO_PWM_MODE
    default "3"

config CMDQ_ENABLE
    def_bool y

config M2D_ENABLE
    def_bool y
	
config I2C0_ENABLE
    def_bool y

config GPIO_IIC0_CLK
    default "43"

config GPIO_IIC0_DATA
    default "42"

config GPIO_IIC0_MODE
    default "1"


config UART0_ENABLE
    def_bool n

config UART1_ENABLE
    def_bool y

config GPIO_UART1_TX
    default "4"

config GPIO_UART1_RX
    default "-1"

config CAPTURE_DEFINE
    default "DEMO_972_Lobby_NT99141.txt"

config SENSOR_ENABLE
    def_bool y

config CAPTURE_SENSOR
    default "NT99141.c"

config GPIO_SN1_RST
    default "41"

config GPIO_SN1_PWN
    default "40"

config GPIO_SN1_LED
    default "57"

config GPIO_SN1_MCLK
    default "47"

config VIDEO_ENABLE
    def_bool y

config STC_ENABLE
    def_bool y

config FS_FAT
    def_bool y

config ITU_UCL_ENABLE
    def_bool n

config BUILD_INIPARSER
    def_bool n

config BUILD_ITU
    def_bool y

config BUILD_SDL
    def_bool y

config TASK_DRIVE_PROBE
    def_bool y

config RECORD_VIDEO
    def_bool n


source "$CMAKE_SOURCE_DIR/sdk/Kconfig"


menu "CAP TEST FUNCTION"

    choice
        prompt "Test CAP"
        default CAP_MODULE_MODE
    config CAP_MODULE_MODE
        bool "CAP_MODULE_MODE"
        help
            Peripheral->SENSOR ENABLE = true
    config CAP_HDMIRX_MODE
        bool "CAP_HDMIRX_MODE"
        help
            Peripheral->HDMI RX ENABLE = true
			
    config CAP_DELAYWINDOWS_MODE
        bool "CAP_DELAYWINDOWS_MODE"
        help
            Scan Delay Windows.
    endchoice

endmenu
```

## ite_sdk/ite_sdk/project/test_cap/Kconfig.win32
```kconfig
#
# For a description of the syntax of this configuration file,
# see Documentation/kbuild/kconfig-language.txt.
#

mainmenu "Project Configuration"


config TEST_VIDEO
    bool
    default y
    select HAVE_LCD
    select HAVE_GRAPHICS
    select HAVE_VIDEO

config LCD_ENABLE
    def_bool y

config VIDEO_ENABLE
    def_bool y

config CMAKE_SOURCE_DIR
    string
    option env="CMAKE_SOURCE_DIR"

config DEF_CPU_FA626
    def_bool y

source "$CMAKE_SOURCE_DIR/sdk/Kconfig"
```

## ite_sdk/ite_sdk/project/test_ecm/Kconfig.L610.ngpl
```kconfig
#
# For a description of the syntax of this configuration file,
# see Documentation/kbuild/kconfig-language.txt.
#

mainmenu "Project Configuration"

config CMAKE_SOURCE_DIR
    string
    option env="CMAKE_SOURCE_DIR"

config DEF_CHIP_PKG_IT972
    def_bool y

config ROM_COMPRESS
    def_bool n

#==== for uart log ====    
config UART1_ENABLE
    def_bool y

config GPIO_UART1_TX
    default "4"

config GPIO_UART1_RX
    default "-1"

#==== for USB ====
config USBHCC
    def_bool y

config USBHCC_HOST
    def_bool y

config USBH_CD_CDCECM_HCC
    def_bool y
    
config USBH_CD_CDCACM
    def_bool y

#==== for NET device ====
config NET_ENABLE
    def_bool y

config NET_ETHERNET
    def_bool n

config NET_ETHERNET_4G
    def_bool y

config DEF_NET_L610_4G
    def_bool y

config DEF_USBH_CD_CDCECM
    def_bool y

#==== for NET protocol ====
config NET_HTTP
    def_bool y

config NET_FTP
    def_bool y
    
config PING
	def_bool y

config DBG_INIT_SCRIPT
    default "IT970A0_396Mhz_DDR2_396Mhz.txt"



source "$CMAKE_SOURCE_DIR/sdk/Kconfig"


menu "ECM Network Test"

choice
    prompt "Test App"
    default TEST_HTTP

config TEST_PING
    bool "Ping Test"
    help
        Test with Ping.

config PING_IP
    string "IP"
    depends on TEST_PING
    default "172.217.160.78"
    help
        google: 172.217.160.78

config TEST_HTTP
    bool "Http Download Test"
    help
        Test with http download.

config HTTP_URL
    string "URL"
    depends on TEST_HTTP
    default "http://http.speed.hinet.net/test_020m.zip"
    help
        Set URL for http downlad.

config TEST_FTP_UPLOAD
    bool "Ftp Upload Test"
    help
        Test with ftp upload.

config FTP_URL
    string "URL"
    depends on TEST_FTP_UPLOAD
    default "ftp.speed.hinet.net/uploads/"
    help
        Set URL for ftp upload. 
        File name is "test_020m.zip".
        FTP source is "A:/test_020m.zip".

endchoice

endmenu
```

## ite_sdk/ite_sdk/project/test_ecm/Kconfig.M8910DL
```kconfig
#
# For a description of the syntax of this configuration file,
# see Documentation/kbuild/kconfig-language.txt.
#

mainmenu "Project Configuration"

config CMAKE_SOURCE_DIR
    string
    option env="CMAKE_SOURCE_DIR"

config DEF_CHIP_PKG_IT972
    def_bool y

config ROM_COMPRESS
    def_bool n

#==== for uart log ====    
config UART1_ENABLE
    def_bool y

config GPIO_UART1_TX
    default "4"

config GPIO_UART1_RX
    default "-1"

#==== for USB ====
config USB0_ENABLE
    def_bool y

config USB1_ENABLE
    def_bool y

config USB_SERIAL
    def_bool y
		
config USB_OPTION
    def_bool y

#==== for NET device ====
config NET_ENABLE
    def_bool y

config NET_ETHERNET
    def_bool n

config NET_ETHERNET_4G
    def_bool y

config DEF_NET_M8910DL_4G
    def_bool y

config DEF_USB_ECM
    def_bool y

#==== for NET protocol ====
config NET_HTTP
    def_bool y

config NET_FTP
    def_bool y
    
config PING
	def_bool y

config DBG_INIT_SCRIPT
    default "IT970A0_396Mhz_DDR2_396Mhz.txt"



source "$CMAKE_SOURCE_DIR/sdk/Kconfig"


menu "ECM Network Test"

choice
    prompt "Test App"
    default TEST_HTTP

config TEST_PING
    bool "Ping Test"
    help
        Test with Ping.

config PING_IP
    string "IP"
    depends on TEST_PING
    default "172.217.160.78"
    help
        google: 172.217.160.78

config TEST_HTTP
    bool "Http Download Test"
    help
        Test with http download.

config HTTP_URL
    string "URL"
    depends on TEST_HTTP
    default "http://http.speed.hinet.net/test_020m.zip"
    help
        Set URL for http downlad.

config TEST_FTP_UPLOAD
    bool "Ftp Upload Test"
    help
        Test with ftp upload.

config FTP_URL
    string "URL"
    depends on TEST_FTP_UPLOAD
    default "ftp.speed.hinet.net/uploads/"
    help
        Set URL for ftp upload. 
        File name is "test_020m.zip".
        FTP source is "A:/test_020m.zip".

endchoice

endmenu
```

## ite_sdk/ite_sdk/project/test_ecm/Kconfig.N720.eth
```kconfig
#
# For a description of the syntax of this configuration file,
# see Documentation/kbuild/kconfig-language.txt.
#

mainmenu "Project Configuration"

config CMAKE_SOURCE_DIR
    string
    option env="CMAKE_SOURCE_DIR"

config DEF_CHIP_PKG_IT972
    def_bool y

config ROM_COMPRESS
    def_bool n

#==== for uart log ====    
config UART1_ENABLE
    def_bool y

config GPIO_UART1_TX
    default "4"

config GPIO_UART1_RX
    default "-1"

#==== for USB ====
config USB0_ENABLE
    def_bool y

config USB1_ENABLE
    def_bool y

config USB_SERIAL
    def_bool y
		
config USB_OPTION
    def_bool y

#==== for NET device ====
config NET_ENABLE
    def_bool y

config NET_ETHERNET_4G
    def_bool y

config DEF_NET_N720_4G
    def_bool y

config DEF_USB_ECM_EX
    def_bool y

#==== for NET protocol ====
config NET_HTTP
    def_bool y

config NET_FTP
    def_bool y
    
config PING
	def_bool y
	
	
#==== for Ethernet ===
config NET_ETHERNET
    def_bool y

config DEF_NET_RTL8201FL
    def_bool y

config NET_ETHERNET_PHY_ADDR
    default "0"

config NET_ETHERNET_LINK_INTR
    default y

config GPIO_ETHERNET
    default "25, 26, 27, 28, 29, 30, 31, 36, 37, 38"

config GPIO_ETHERNET_LINK
    default "39"

	
#==== for SD ====
config SD0_ENABLE
    def_bool y

config SD0_STATIC
    default y

config GPIO_SD0_POWER_ENABLE
    default "-1"

config GPIO_SD0_WRITE_PROTECT
    default "-1"

config GPIO_SD0_IO
      default "15, 5, 7, 8, 9, 10, -1, -1, -1, -1"
	
config TASK_DRIVE_PROBE	
	def_bool y

config FS_FAT
	def_bool y	

config DBG_INIT_SCRIPT
    default "IT970A0_396Mhz_DDR2_396Mhz.txt"



source "$CMAKE_SOURCE_DIR/sdk/Kconfig"


menu "ECM Network Test"

choice
    prompt "Test App"
    default TEST_HTTP

config TEST_PING
    bool "Ping Test"
    help
        Test with Ping.

config PING_IP
    string "IP"
    depends on TEST_PING
    default "172.217.160.78"
    help
        google: 172.217.160.78

config TEST_HTTP
    bool "Http Download Test"
    help
        Test with http download.

config HTTP_URL
    string "URL"
    depends on TEST_HTTP
    default "http://http.speed.hinet.net/test_020m.zip"
    help
        Set URL for http downlad.

config TEST_FTP_UPLOAD
    bool "Ftp Upload Test"
    help
        Test with ftp upload.

config FTP_URL
    string "URL"
    depends on TEST_FTP_UPLOAD
    default "ftp.speed.hinet.net/uploads/"
    help
        Set URL for ftp upload. 
        File name is "test_020m.zip".
        FTP source is "A:/test_020m.zip".

endchoice

config TEST_ETHERNET
    bool "Enable Ethernet Test"
    depends on NET_ETHERNET
    default y
    help
        Test with static IP and ping PC with IP: 192.168.1.100
        Our IP is 192.168.1.1
        
endmenu
```

## ite_sdk/ite_sdk/project/test_ecm/Kconfig.N720.option.ngpl
```kconfig
#
# For a description of the syntax of this configuration file,
# see Documentation/kbuild/kconfig-language.txt.
#

mainmenu "Project Configuration"

config CMAKE_SOURCE_DIR
    string
    option env="CMAKE_SOURCE_DIR"


config ROM_COMPRESS
    def_bool n

#==== for uart log ====    
config UART1_ENABLE
    def_bool y

config GPIO_UART1_TX
    default "4"

config GPIO_UART1_RX
    default "-1"

#==== for USB ====
config USBHCC
    def_bool y

config USBHCC_HOST
    def_bool y

config USBH_CD_CDCACM
    def_bool y

#==== for NET device ====
config NET_ENABLE
    def_bool y

config NET_ETHERNET
    def_bool n

config NET_ETHERNET_4G
    def_bool y

config DEF_NET_N720_4G
    def_bool y


source "$CMAKE_SOURCE_DIR/sdk/Kconfig"


menu "Test"

endmenu
```
